## components/badge23/Kconfig
```kconfig
menu "Badge23 Config"
    choice BADGE23_HW_GEN
        prompt "Badge23 Hardware Generation"
        default BADGE23_HW_GEN_P4
        config BADGE23_HW_GEN_P1
            help
                Protoype version 1, a.k.a. proto1. Very early protoype.
                Visual identifiers:
                 - No line in/out jacks
                 - White bottom board
                 - USB-C jack points side of leaf
            bool "Prototype 1"
        config BADGE23_HW_GEN_P3
            help
                Prototype version 3, a.k.a. proto3
                Visual identifiers:
                  - Sticker with B3xx (xx being arbitrary digits) on the back
            bool "Prototype 3"
        config BADGE23_HW_GEN_P4
            help
                Prototype version 4, a.k.a. proto4
                Visual identifiers:
                  - Sticker with B4xx (xx being arbitrary digits) on the back
            bool "Prototype 4"
        config BADGE23_HW_GEN_P6
            help
                Prototype version 6, a.k.a. proto6
                  - Sticker with B6xx (xx being arbitrary digits) on the back
            bool "Prototype 6"
    endchoice

    choice BADGE23_TOP_BOARD_STYLE
        prompt "Badge23 top board style (mainly for proto6)"
        default BADGE23_TOP_BOARD_SPIKES
        config BADGE23_TOP_BOARD_SPIKES
            help
                Spikes between captouch pads
            bool "Spikes"
        config BADGE23_TOP_BOARD_SPIRALS
            help
                Spirals between captouch pads
            bool "Spirals"
    endchoice

endmenu
```

## components/flow3r_bsp/Kconfig
```kconfig
menu "Flow3r Config"
    choice FLOW3R_HW_GEN
        prompt "Badge23 Hardware Generation"
        default FLOW3R_HW_GEN_P4
        config FLOW3R_HW_GEN_P3
            help
                Prototype version 3, a.k.a. proto3
                Visual identifiers:
                  - Sticker with B3xx (xx being arbitrary digits) on the back
            select FLOW3R_ESP32S3
            bool "Prototype 3"
        config FLOW3R_HW_GEN_P4
            help
                Prototype version 4, a.k.a. proto4
                Visual identifiers:
                  - Sticker with B4xx (xx being arbitrary digits) on the back
            select FLOW3R_ESP32S3
            bool "Prototype 4"
        config FLOW3R_HW_GEN_P6
            help
                Prototype version 6, a.k.a. proto6
                  - Sticker with B6xx (xx being arbitrary digits) on the back
            select FLOW3R_ESP32S3
            bool "Prototype 6"
    endchoice

    choice FLOW3R_TOP_BOARD_STYLE
        prompt "Badge23 top board style (mainly for proto6)"
        default FLOW3R_TOP_BOARD_SPIRALS
        config FLOW3R_TOP_BOARD_SPIKES
            help
                Spikes between captouch pads
            bool "Spikes"
        config FLOW3R_TOP_BOARD_SPIRALS
            help
                Spirals between captouch pads
            bool "Spirals"
    endchoice

    config FLOW3R_ESP32S3
        bool

endmenu
```

## recovery/sdkconfig.defaults
```kconfig
CONFIG_BOOTLOADER_LOG_LEVEL_WARN=y
CONFIG_APP_EXCLUDE_PROJECT_VER_VAR=y
CONFIG_APP_EXCLUDE_PROJECT_NAME_VAR=y
CONFIG_ESPTOOLPY_FLASHMODE_QIO=y
CONFIG_ESPTOOLPY_FLASHSIZE_16MB=y
CONFIG_ESPTOOLPY_AFTER_NORESET=y
CONFIG_PARTITION_TABLE_CUSTOM=y
CONFIG_PARTITION_TABLE_CUSTOM_FILENAME="partitions.csv"
CONFIG_COMPILER_OPTIMIZATION_PERF=y
CONFIG_COMPILER_OPTIMIZATION_ASSERTIONS_SILENT=y
CONFIG_SPIRAM=y
CONFIG_SPIRAM_MODE_OCT=y
CONFIG_SPIRAM_TYPE_ESPPSRAM64=y
CONFIG_SPIRAM_SPEED_80M=y
CONFIG_SPIRAM_TRY_ALLOCATE_WIFI_LWIP=y
CONFIG_SPIRAM_MALLOC_RESERVE_INTERNAL=65536
CONFIG_SPIRAM_ALLOW_BSS_SEG_EXTERNAL_MEMORY=y
CONFIG_ESP_DEFAULT_CPU_FREQ_MHZ_240=y
CONFIG_ESP32S3_INSTRUCTION_CACHE_32KB=y
CONFIG_ESP32S3_DATA_CACHE_64KB=y
CONFIG_ESP32S3_DATA_CACHE_LINE_64B=y
CONFIG_ESP_CONSOLE_USB_SERIAL_JTAG=y
CONFIG_FATFS_LFN_HEAP=y
CONFIG_FATFS_API_ENCODING_UTF_8=y
CONFIG_LOG_DEFAULT_LEVEL_INFO=y
CONFIG_FLOW3R_HW_GEN_P6=y
CONFIG_FLOW3R_CTX_FLAVOUR_SMOL=y
```

## sdkconfig.defaults
```kconfig
CONFIG_BOOTLOADER_LOG_LEVEL_WARN=y
CONFIG_APP_EXCLUDE_PROJECT_VER_VAR=y
CONFIG_APP_EXCLUDE_PROJECT_NAME_VAR=y
CONFIG_ESPTOOLPY_FLASHMODE_QIO=y
CONFIG_ESPTOOLPY_FLASHSIZE_16MB=y
CONFIG_ESPTOOLPY_AFTER_NORESET=y
CONFIG_PARTITION_TABLE_CUSTOM=y
CONFIG_PARTITION_TABLE_CUSTOM_FILENAME="partitions.csv"
CONFIG_COMPILER_OPTIMIZATION_PERF=y
CONFIG_COMPILER_OPTIMIZATION_ASSERTIONS_DISABLE=y
CONFIG_BT_ENABLED=y
CONFIG_BT_NIMBLE_ENABLED=y
CONFIG_BT_NIMBLE_MAX_CONNECTIONS=4
CONFIG_BT_NIMBLE_PINNED_TO_CORE_1=y
# CONFIG_PM_POWER_DOWN_CPU_IN_LIGHT_SLEEP is not set
CONFIG_SPIRAM=y
CONFIG_SPIRAM_MODE_OCT=y
CONFIG_SPIRAM_TYPE_ESPPSRAM64=y
CONFIG_SPIRAM_SPEED_80M=y
CONFIG_SPIRAM_TRY_ALLOCATE_WIFI_LWIP=y
CONFIG_SPIRAM_MALLOC_RESERVE_INTERNAL=65536
CONFIG_SPIRAM_ALLOW_BSS_SEG_EXTERNAL_MEMORY=y
CONFIG_ESP_DEFAULT_CPU_FREQ_MHZ_240=y
CONFIG_ESP32S3_INSTRUCTION_CACHE_32KB=y
CONFIG_ESP32S3_DATA_CACHE_64KB=y
CONFIG_ESP32S3_DATA_CACHE_LINE_64B=y
CONFIG_ESP_CONSOLE_USB_SERIAL_JTAG=y
# CONFIG_ESP_TASK_WDT_CHECK_IDLE_TASK_CPU0 is not set
# CONFIG_ESP_TASK_WDT_CHECK_IDLE_TASK_CPU1 is not set
CONFIG_FATFS_LFN_HEAP=y
CONFIG_FATFS_API_ENCODING_UTF_8=y
CONFIG_FREERTOS_THREAD_LOCAL_STORAGE_POINTERS=2
CONFIG_FREERTOS_VTASKLIST_INCLUDE_COREID=y
CONFIG_FREERTOS_GENERATE_RUN_TIME_STATS=y
CONFIG_FREERTOS_ENABLE_STATIC_TASK_CLEAN_UP=y
CONFIG_LOG_DEFAULT_LEVEL_ERROR=y
CONFIG_LWIP_PPP_SUPPORT=y
CONFIG_LWIP_PPP_PAP_SUPPORT=y
CONFIG_LWIP_PPP_CHAP_SUPPORT=y
```
